## CMakeLists.txt
```
cmake_minimum_required(VERSION 3.20.0)
find_package(Zephyr REQUIRED HINTS $ENV{ZEPHYR_BASE})

project(NRFGateway)

target_sources(app PRIVATE
    src/main.c
    src/core/gw_store.c
    src/core/event_ingest.c
    src/core/semantic_handler.c
    src/core/command_router.c
    src/core/reliability_manager.c
    src/core/rule_engine.c
    src/core/nus_handler.c
    src/core/transport_port.c
    src/core/scheduler.c
    src/core/gw_addr.c
    src/transports/ble_mesh/ble_mesh_adapter.c
    src/transports/ble_mesh/ble_mesh_prov.c
    src/transports/ble_mesh/ble_mesh_codec.c
    src/transports/thread/thread_adapter.c
    src/transports/thread/thread_codec.c
    src/transports/lorawan/lorawan_adapter.c
    src/transports/lorawan/lora_wire_format.c
    src/drivers/ble_nus.c
    src/drivers/mesh_ctrl.c)

target_include_directories(app PRIVATE
    inc
    inc/core
    inc/transports/ble_mesh
    inc/transports/thread
    inc/transports/lorawan
    inc/drivers)
```

## prj.conf
```kconfig
# ============================================================
# Logging
# ============================================================
CONFIG_LOG=y
CONFIG_LOG_MODE_MINIMAL=y
CONFIG_LOG_DEFAULT_LEVEL=2

# ============================================================
# Bluetooth Core
# ============================================================
CONFIG_BT=y
CONFIG_BT_HCI=y
CONFIG_BT_OBSERVER=y
CONFIG_BT_BROADCASTER=y
CONFIG_BT_PERIPHERAL=y
CONFIG_BT_CENTRAL=y

# ============================================================
# Bluetooth Mesh (reduced radio footprint for coexistence)
# ============================================================
CONFIG_BT_MESH=y
CONFIG_BT_MESH_RELAY=n
CONFIG_BT_MESH_PB_ADV=y
CONFIG_BT_MESH_PB_GATT=n
CONFIG_BT_MESH_GATT_PROXY=n
CONFIG_BT_MESH_CFG_CLI=y
CONFIG_BT_MESH_CFG_CLI_TIMEOUT=5000
CONFIG_BT_MESH_PROVISIONER=y
CONFIG_BT_MESH_CDB=y
CONFIG_BT_MESH_CDB_NODE_COUNT=20
CONFIG_BT_MESH_CRPL=32
CONFIG_BT_MESH_NETWORK_TRANSMIT_COUNT=2
CONFIG_BT_MESH_NETWORK_TRANSMIT_INTERVAL=20
CONFIG_BT_MESH_UNPROV_BEACON_INT=10
CONFIG_BT_BUF_ACL_TX_COUNT=3
CONFIG_BT_BUF_EVT_RX_COUNT=16
CONFIG_BT_BUF_ACL_TX_SIZE=251
CONFIG_BT_DEVICE_NAME="NRFGateway"
CONFIG_BT_MAX_CONN=2
# CONFIG_BT_EXT_ADV=y
# CONFIG_BT_MESH_ADV_EXT=y
CONFIG_BT_MESH_RX_SEG_MAX=8
CONFIG_BT_MESH_RX_SEG_MSG_COUNT=6
CONFIG_BT_MESH_ONOFF_CLI=y

# ============================================================
# Hardware
# ============================================================
CONFIG_DK_LIBRARY=y
CONFIG_HWINFO=y

# ============================================================
# System / Stacks
# ============================================================
CONFIG_MAIN_STACK_SIZE=4096
CONFIG_SYSTEM_WORKQUEUE_STACK_SIZE=6144
CONFIG_BT_MESH_ADV_STACK_SIZE=4096
CONFIG_BT_RX_STACK_SIZE=4069
CONFIG_BT_LONG_WQ_STACK_SIZE=2048
# Only relevant if CONFIG__LOG_MODE_MINIMAL=n
# CONFIG_LOG_PROCESS_THREAD_STACK_SIZE=1024

# ============================================================
# OpenThread (must match ESP32-C6 dataset)
# ============================================================
CONFIG_OPENTHREAD=y
CONFIG_OPENTHREAD_FTD=y
CONFIG_NET_L2_OPENTHREAD=y
CONFIG_OPENTHREAD_CHANNEL=11
CONFIG_OPENTHREAD_PANID=43981
CONFIG_OPENTHREAD_NETWORK_NAME="NRFGate"
CONFIG_OPENTHREAD_XPANID="de:ad:be:ef:ca:fe:ba:be"
CONFIG_OPENTHREAD_NETWORKKEY="00112233445566778899aabbccddeeff"
CONFIG_OPENTHREAD_MANUAL_START=y
CONFIG_OPENTHREAD_PLATFORM_NETIF=y
CONFIG_OPENTHREAD_BLE_TCAT=n

# ── OpenThread RAM-Tuning ─────────────────────────────────────
# NOTE: CONFIG_OPENTHREAD_NUM_MESSAGE_BUFFERS hat in NCS v3.2.1
# ein hartes Minimum von 96 (nicht reduzierbar). Default bleibt.

# MAX_CHILDREN: default 10 ist bei 9+ Kindern KNAPP — ein neues
# Device das joint bringt dich übers Limit. Explizit auf 12 für
# Reserve. Kconfig-Name kann je nach NCS-Version variieren —
# prüfe mit `west build -t menuconfig` (Suche: MAX_CHILDREN).
CONFIG_OPENTHREAD_MAX_CHILDREN=12

# Address Cache: 20 → 16 (EID→RLOC16 Mappings)
CONFIG_OPENTHREAD_TMF_ADDRESS_CACHE_ENTRIES=16

# ============================================================
# Networking / IPv6 / UDP / Sockets
# ============================================================
CONFIG_NETWORKING=y
CONFIG_NET_IPV6=y
CONFIG_NET_UDP=y
CONFIG_NET_SOCKETS=y
CONFIG_NET_CONFIG_SETTINGS=y
CONFIG_NET_CONFIG_AUTO_INIT=y
CONFIG_NET_CONFIG_INIT_TIMEOUT=0

# ── Net Stack RAM-Tuning ──────────────────────────────────────
# net_buf Pools: 36 (default) → 24. Jedes net_buf ~76 B,
CONFIG_NET_PKT_RX_COUNT=18
CONFIG_NET_PKT_TX_COUNT=18
CONFIG_NET_BUF_RX_COUNT=54
CONFIG_NET_BUF_TX_COUNT=54

# ============================================================
# CoAP / JSON
# ============================================================
CONFIG_COAP=y
CONFIG_JSON_LIBRARY=y

# ============================================================
# Multiprotocol (BLE + 802.15.4 on single radio)
# ============================================================
CONFIG_MPSL=y
CONFIG_MPSL_TIMESLOT_SESSION_COUNT=1
CONFIG_BT_LL_SOFTDEVICE=y

# ============================================================
# Settings / Flash / Persistence
# ============================================================
CONFIG_FLASH=y
CONFIG_ZMS=y
CONFIG_SETTINGS=y
CONFIG_SETTINGS_ZMS=y
CONFIG_BT_SETTINGS=y
CONFIG_TRUSTED_STORAGE_STORAGE_BACKEND_SETTINGS=y
CONFIG_REBOOT=y
CONFIG_NORDIC_QSPI_NOR=n
CONFIG_SPI_NOR=n

# ============================================================
# OT Shell (for debugging)
# ============================================================
# CONFIG_SHELL=y
# CONFIG_SHELL_BACKEND_SERIAL=y
# CONFIG_OPENTHREAD_SHELL=y
# CONFIG_SHELL_STACK_SIZE=1024

CONFIG_BT_NUS=y

CONFIG_LORA=y

# CONFIG_LORA_LOG_LEVEL_DBG=y
# CONFIG_SPI_LOG_LEVEL_DBG=y
CONFIG_SYSTEM_WORKQUEUE_PRIORITY=-10


CONFIG_BT_L2CAP_TX_MTU=247
CONFIG_BT_BUF_ACL_RX_SIZE=251

# ── NUS Connection Stability ──────────────────────────────────
# Default supervision timeout (~720ms) too short when gateway
# shares radio between BLE Mesh windows and Thread windows.
# Longer timeout = connection survives busy radio periods.
CONFIG_BT_PERIPHERAL_PREF_MIN_INT=60
CONFIG_BT_PERIPHERAL_PREF_MAX_INT=90
CONFIG_BT_PERIPHERAL_PREF_LATENCY=0
CONFIG_BT_PERIPHERAL_PREF_TIMEOUT=600

CONFIG_BT_MESH_SEQ_STORE_RATE=50

CONFIG_HEAP_MEM_POOL_SIZE=0


CONFIG_NRF_802154_RX_BUFFERS=32
CONFIG_BT_MESH_ADV_BUF_COUNT=20
CONFIG_BT_MESH_TX_SEG_MAX=32
# # ============================================================
# # Stack debugging
# # ============================================================
# CONFIG_THREAD_NAME=y
# CONFIG_THREAD_MONITOR=y
# CONFIG_THREAD_ANALYZER=y
# CONFIG_THREAD_ANALYZER_AUTO=y
# CONFIG_THREAD_ANALYZER_AUTO_INTERVAL=30
# CONFIG_THREAD_ANALYZER_USE_LOG=y
# CONFIG_THREAD_STACK_INFO=y

CONFIG_THREAD_NAME=y
CONFIG_THREAD_STACK_INFO=y
CONFIG_INIT_STACKS=y
CONFIG_HW_STACK_PROTECTION=y
```

## src/main.c
```c
/**
 * @file main.c
 * @brief BLE Mesh + Thread Multiprotocol Gateway (nRF54L15-DK)
 *
 * Runs BLE Mesh and OpenThread on a single radio using application-level
 * scheduling via bt_mesh_suspend()/bt_mesh_resume().
 *
 * Boot sequence:
 *   1. Thread network forms      (60 s wait)
 *   2. BLE Mesh initialises      (bt_ready callback)
 *   3. Settle period             (5 s)
 *   4. BLE NUS advertising starts
 *   5. Radio scheduler starts    (sched_thread_ms / sched_ble_ms cycling)
 *
 * Buttons:
 *   Button 3 — Factory reset (clear CDB + mesh reset + reboot)
 *   Button 2 — Open provisioning window (30 s)
 */

#include <zephyr/kernel.h>
#include <zephyr/logging/log.h>
#include <zephyr/bluetooth/bluetooth.h>
#include <zephyr/settings/settings.h>
#include <dk_buttons_and_leds.h>

#include "main.h"
#include "gw_model.h"
#include "gw_store.h"
#include "event_ingest.h"
#include "semantic_handler.h"
#include "command_router.h"
#include "reliability_manager.h"
#include "ble_mesh_adapter.h"
#include "ble_mesh_prov.h"
#include "thread_adapter.h"
#include "lorawan_adapter.h"
#include "ble_nus.h"
#include "nus_handler.h"
#include "scheduler.h"
#include "rule_engine.h"
#include "gw_addr.h"

LOG_MODULE_REGISTER(main, LOG_LEVEL_INF);

//* ── Semantic Tick Timer ───────────────────────────────────── */

#define SEMANTIC_TICK_MS 1000

static void semantic_tick_handler(struct k_work *work);
static K_WORK_DELAYABLE_DEFINE(s_semantic_tick_work, semantic_tick_handler);

static void semantic_tick_handler(struct k_work *work)
{
    semantic_handler_tick();
    k_work_schedule(&s_semantic_tick_work, K_MSEC(SEMANTIC_TICK_MS));
}

/* ── Button Handler ────────────────────────────────────────── */

static void button_handler(uint32_t button_state, uint32_t has_changed)
{
    if ((has_changed & DK_BTN4_MSK) && (button_state & DK_BTN4_MSK)) {
        LOG_INF("Button 4 — opening provisioning window");
        ble_mesh_prov_start_window();
    }
}

/* ── BLE Mesh LOST Callback ────────────────────────────────── */

static bool node_is_lost(uint16_t mesh_addr)
{
    gw_node_addr_t addr;
    gw_addr_from_mesh(&addr, mesh_addr);
    
    int idx = gw_store_find_node(&addr);
    if (idx < 0) {
        return false;
    }

    gw_node_record_t rec;
    if (!gw_store_get_node_copy((uint8_t)idx, &rec)) {
        return false;
    }
    return rec.state == GW_STATE_LOST;
}

static void store_listener(const gw_event_t *evt, void *ctx)
{
    ARG_UNUSED(ctx);
    gw_store_apply_event(evt);
}

int main(void)
{
    LOG_INF("=== Gateway Boot ===");
    int err;

    // 1. Core Layer
    gw_store_init();
    event_ingest_init();

    // 2. Register Listener
    event_ingest_register_listener(store_listener, NULL);
    semantic_handler_init();
    command_router_init();
    reliability_manager_init();

    // 3. Buttons and LEDs
    err = dk_buttons_init(button_handler);
     if (err) {
        LOG_ERR("Buttons init failed: %d", err);
        return err;
    }
    err = dk_leds_init();
    if (err) {
        LOG_ERR("LED init failed: %d", err);
        return err;
    }
    dk_set_led_off(DK_LED1);
    dk_set_led_off(DK_LED2);
    dk_set_led_off(DK_LED3);
    dk_set_led_off(DK_LED4);

    // 4. Bluetooth
    err = bt_enable(NULL);
    if (err) {
        LOG_ERR("Bluetooth init failed: %d", err);
        return err;
    }
    LOG_INF("Bluetooth enabled");

    // 5. Register NUS
    err = ble_nus_register();
    if (err) {
        LOG_ERR("ble_nus_register failed: %d", err);
        return err;
    }

    // 6. Load settings
    if (IS_ENABLED(CONFIG_SETTINGS)) {
        err = settings_load();
        if (err) {
            LOG_ERR("Failed to load settings: %d", err);
        } else {
            LOG_INF("Settings loaded");
        }
    }

    // 7. BLE Mesh
    ble_mesh_adapter_setup();
    ble_mesh_prov_init();
    ble_mesh_prov_set_lost_cb(node_is_lost);

    const struct bt_mesh_comp *comp = ble_mesh_adapter_comp_init();
    const struct bt_mesh_prov *prov = ble_mesh_adapter_prov_get();

    err = bt_mesh_init(prov, comp);
    if (err) {
        LOG_ERR("Mesh initialization failed: %d", err);
        return err;
    }
    LOG_INF("Mesh initialized");

    ble_mesh_prov_self_provision();

    // 8. NUS Handler + Advertising
    nus_handler_init();

    thread_adapter_setup();
    err = thread_adapter_start();
    if (err) {
        LOG_ERR("Thread adapter init failed: %d", err);
        return err;
    }

    err = ble_nus_advertise();
    if (err) {
        LOG_ERR("ble_nus_advertise failed: %d", err);
        /* non-fatal */
    }
    // 9. Thread/CoAP

    // 10. LoRaWAN
    lorawan_adapter_setup();
    err = lorawan_adapter_start();
    if (err) {
        LOG_ERR("LoRaWAN adapter init failed: %d", err);
        return err;
    }

    // 11. Start semantic tick
    k_work_schedule(&s_semantic_tick_work, K_MSEC(SEMANTIC_TICK_MS));
    rule_engine_init();


    gw_node_addr_t mesh_test;
    gw_addr_from_mesh(&mesh_test, 0x0042);
    LOG_INF("route(mesh) = %d (expected %d)", gw_addr_route(&mesh_test), GW_TR_BLE_MESH);

    gw_node_addr_t lora_test;
    gw_addr_from_lorawan(&lora_test, 0xAABB000000000001ULL);
    LOG_INF("route(lora) = %d (expected %d)", gw_addr_route(&lora_test), GW_TR_LORAWAN);

    /* Fake-Thread: andere fd-Adresse */
    gw_node_addr_t fake_thread = {0};
    fake_thread.ipv6[0] = 0xfd;
    fake_thread.ipv6[1] = 0xab;  /* nicht deine GID */
    LOG_INF("route(fake_thread) = %d (expected %d)", gw_addr_route(&fake_thread), GW_TR_THREAD);

    /* Junk: nicht-fd */
    gw_node_addr_t junk = {0};
    junk.ipv6[0] = 0x20;
    LOG_INF("route(junk) = %d (expected %d)", gw_addr_route(&junk), GW_TR_UNKNOWN);
    LOG_INF("=== Gateway Initialization Complete ===");

    scheduler_start();

    while (1) {
        k_sleep(K_SECONDS(10));
        LOG_DBG("Nodes: %u", gw_store_count());
    }
}
```

## inc/ble_mesh_handler.h
```c
#ifndef BLE_MESH_HANDLER_H
#define BLE_MESH_HANDLER_H
 
#include <zephyr/bluetooth/mesh.h>
 
const struct bt_mesh_prov *ble_mesh_handler_prov_init(void);
const struct bt_mesh_comp *ble_mesh_handler_comp_init(void);
void ble_mesh_handler_self_provision(void);
void ble_mesh_handler_start_provisioning(void);
 
/**
 * @brief Unprovision a BLE Mesh node by its unicast address.
 *
 * Sends Config Node Reset to the node (so it returns to unprovisioned
 * state and starts beaconing again), then removes it from the local CDB.
 *
 * Safe to call from any context — the actual mesh operation is
 * dispatched to the config work queue internally.
 *
 * @param mesh_addr  Unicast mesh address of the node to unprovision
 */
void ble_mesh_handler_unprovision_node(uint16_t mesh_addr);
 
void ble_mesh_handler_reconfigure_node(uint16_t mesh_addr);
#endif /* BLE_MESH_HANDLER_H */
 
void ble_mesh_handler_purge_lost_nodes(void);
void ble_mesh_handler_full_reset(void);
```

## inc/ble_nus.h
```c
#pragma once
#include <stddef.h>

int  ble_nus_advertise(void);
void ble_nus_send(const char *json);
bool ble_nus_is_ready(void);
int  ble_nus_register(void);
```

## inc/data_handler.h
```c
/**
 * @file data_handler.h
 * @brief Centralized sensor data processing
 *
 * This module owns everything that happens *after* a packet arrives:
 * node registration, data storage, logging, and later forwarding
 * (BLE, LoRa, MQTT, ...).
 *
 *  - Maintains a node table mapping IPv6 addresses to node indices
 *  - Logs received sensor data with node context
 */

#ifndef DATA_HANDLER_H
#define DATA_HANDLER_H

#include <zephyr/kernel.h>

// testing
#include "semantic_handler.h"

#define MAX_NODES 8
#define NODE_ADDR_STR_LEN 46   // INET6_ADDRSTRLEN

//===============================================================
// Transport identity
//===============================================================
typedef enum{
    NODE_TRANSPORT_THREAD,      // source = IPv6 address string
    NODE_TRANSPORT_BLE_MESH,    // source = 16 bit mesh address
    //NODE_TRANSPORT_LORA,      // LoRa future
} node_transport_t;

typedef struct{
    node_transport_t transport;
    union{
        char ipv6[NODE_ADDR_STR_LEN];
        uint16_t mesh_addr;
        // LoRa has no address, maybe use DevEUI or just "lora" string
        // add more transports here
    };
} node_identity_t;

//==============================================================
// sensor presence Bitmask 
//===============================================================

#define SENSOR_HAS_SEQ          BIT(0)
#define SENSOR_HAS_TS           BIT(1)
#define SENSOR_HAS_AX           BIT(2)
#define SENSOR_HAS_AY           BIT(3)
#define SENSOR_HAS_AZ           BIT(4)
#define SENSOR_HAS_GX           BIT(5)
#define SENSOR_HAS_GY           BIT(6)
#define SENSOR_HAS_GZ           BIT(7)

#define SENSOR_HAS_TEMP         BIT(8)
#define SENSOR_HAS_HUM          BIT(9)
#define SENSOR_HAS_TVOC         BIT(10)
#define SENSOR_HAS_ECO2         BIT(11)

#define SENSOR_HAS_HEART_RATE   BIT(12)
#define SENSOR_HAS_SPO2         BIT(13)
#define SENSOR_HAS_RAW_RED      BIT(14)
#define SENSOR_HAS_RAW_IR       BIT(15)
#define SENSOR_HAS_PM25         BIT(16)
#define SENSOR_HAS_PM10         BIT(17)
#define SENSOR_HAS_SWITCH       BIT(18)
#define SENSOR_HAS_LIGHT        BIT(19)
// new nodes here 

// sensor groups for convenience
#define SENSOR_HAS_ACCEL  (SENSOR_HAS_AX | SENSOR_HAS_AY | SENSOR_HAS_AZ)
#define SENSOR_HAS_GYRO   (SENSOR_HAS_GX | SENSOR_HAS_GY | SENSOR_HAS_GZ)
#define SENSOR_HAS_ENV    (SENSOR_HAS_TEMP | SENSOR_HAS_HUM)
#define SENSOR_HAS_AIR    (SENSOR_HAS_TVOC | SENSOR_HAS_ECO2)
#define SENSOR_HAS_BIO    (SENSOR_HAS_HEART_RATE | SENSOR_HAS_SPO2 | SENSOR_HAS_RAW_RED | SENSOR_HAS_RAW_IR)

struct sensor_payload {
    int32_t present;
    int32_t seq;
    int32_t ts;

    // IMU
    int32_t ax, ay, az;
    int32_t gx, gy, gz;

    // environmental data
    int32_t temp, hum;

    // air quality data
    int32_t tvoc, eco2;

    // Biometric data
    int32_t heart_rate, spo2;
    int32_t raw_red, raw_ir;

    uint8_t switch_state;   // 0=off, 1=on, for a generic switch input

    int32_t pm25, pm10;
    uint8_t light_on;       // 0=off, 1=on, for feedback from lamp
    // add more sensor fields here
};

struct node_sensor_data {
    uint8_t node_idx;                   // set by data_handler
    node_identity_t identity;           // filled by caller
    int64_t rx_uptime_ms;               // k_uptime_get() at reception time, set by thread_handler    
    struct sensor_payload payload;
    int8_t  rssi;                       // BLE Mesh: received RSSI (dBm), 0 for Thread
    uint8_t hops;                       // BLE Mesh: relay hop count (0=direct), 0 for Thread
};

//===============================================================
// Actuator command struct
//===============================================================

typedef struct {
    bool known;
    bool light_on;
} node_actuator_state_t;

extern node_actuator_state_t node_actuator_state[MAX_NODES];

//===============================================================
// Internal node table and scheduling state
//===============================================================

typedef struct {
    uint16_t mesh_addr;
    int64_t  last_rx_ms;
    int64_t  estimated_period_ms;
    int64_t  predicted_next_ms;  // last_rx + period
} mesh_node_schedule_t;

//===============================================
// Public API
//===============================================

/**
 * @brief Initialize the data handler (node table, any future queues)
 */
int data_handler_init(void);
 
/**
 * @brief Hand off a received sensor packet for processing.
 *
 * This function:
 *   1. Registers or looks up the source node
 *   2. Logs present fields
 *   3. (Later) forwards data via BLE / LoRa / MQTT
 *
 * @param data  Pointer to packet; the struct is copied internally,
 *              so the caller's stack buffer is safe to reuse.
 */
void data_handler_receive(const struct node_sensor_data *data);

void data_handler_cmd(const char *cmd, uint16_t len);

uint8_t data_handler_get_node_idx_by_mesh_addr(uint16_t mesh_addr);

void identity_str(const node_identity_t *id, char *buf, size_t size);

uint8_t data_handler_get_node_idx_by_ipv6(const char *ipv6);

int data_handler_get_mesh_schedules(mesh_node_schedule_t *out,
                                     uint8_t max_nodes);


// Testing statistics
extern int64_t g_ble_active_ms;
extern int64_t g_thread_active_ms;
extern uint32_t g_ble_switches;
extern uint32_t g_thread_switches;
 
/* Per-Node Diagnose-Info */
typedef struct {
    uint8_t  node_idx;
    uint32_t packet_count;
    int64_t  first_seen_ms;
    int64_t  last_seen_ms;
    int32_t  last_seq;
    uint32_t seq_gaps;
    uint8_t state;
    node_transport_t transport;
    union {
        char     ipv6[NODE_ADDR_STR_LEN];
        uint16_t mesh_addr;
    } addr;
} node_diag_t;
 
/* Gibt Diagnose-Info für alle Nodes zurück */
int data_handler_get_diag(node_diag_t *out, uint8_t max_nodes);

#endif /* DATA_HANDLER_H */
```

## inc/lora_handler.h
```c
#ifndef LORA_HANDLER_H
#define LORA_HANDLER_H

/**
 * @brief Initialize LoRa modem with predefined settings.
 *
 * Configures the modem for 868 MHz operation with SF7, BW125, CR4/5,
 * and a preamble length of 8. Also sets the TX power to 4 dBm.
 *
 * @return 0 on success, negative errno on failure.
 */
int lora_handler_init(void);

/**
 * @brief Send data via LoRa.
 *
 * @param data Binary payload to send.
 * @param len The length of the payload in bytes.
 */
void lora_handler_send(const uint8_t *data, uint8_t len);

#endif /* LORA_HANDLER_H */
```

## inc/main.h
```c
#ifndef MAIN_H
#define MAIN_H

#include <zephyr/kernel.h>

/**
 * @brief Radio scheduler priority transport selection.
 *
 * When a priority window is active the scheduler gives the radio
 * exclusively to one transport for the requested duration, then
 * returns to normal alternating operation automatically.
 */
typedef enum {
    SCHED_PRIORITY_NONE,
    SCHED_PRIORITY_BLE,     /**< BLE Mesh gets radio exclusively */
    SCHED_PRIORITY_THREAD,  /**< Thread gets radio exclusively   */
} sched_priority_t;

typedef enum {
    SCHED_MODE_NORMAL,     /**< Normal alternating operation */
    SCHED_MODE_BLE_ONLY,  /**< BLE Mesh only (Thread suspended) */
    SCHED_MODE_THREAD_ONLY /**< Thread only (BLE Mesh suspended) */
} sched_mode_t;

void mesh_scheduler_pause(void);
void mesh_scheduler_start(void);
void mesh_scheduler_set_timing(uint32_t thread_ms, uint32_t ble_ms);
void mesh_scheduler_set_mode(sched_mode_t mode);

// Testing
void mesh_scheduler_suppress_reports(bool suppress);

extern uint32_t sched_thread_ms;
extern uint32_t sched_ble_ms;
extern sched_mode_t sched_mode;
extern int64_t g_last_mesh_rx_ms;
/**
 * @brief Request priority radio access for one transport.
 *
 * Safe to call from any thread or work handler — uses atomics only.
 * If a priority window is already active this call extends or
 * replaces it.
 *
 * @param transport   Which transport should get the radio
 * @param duration_ms How long to hold priority (ms)
 */
void mesh_scheduler_request_priority(sched_priority_t transport,
                                     uint32_t duration_ms);

int mesh_scheduler_wait_thread_window(uint32_t timeout_ms);
#endif /* MAIN_H */
```

## inc/mesh_parser.h
```c
#ifndef MESH_PARSER_H
#define MESH_PARSER_H

/**
 * @file mesh_parser.h
 * @brief BLE Mesh Sensor Status payload parser.
 *
 * Extracted from ble_mesh_handler.c to allow unit testing.
 * ble_mesh_handler.c includes this header and calls these functions.
 */

#include <stdint.h>
#include <stdbool.h>
#include "data_handler.h"

/* ── Property IDs (BLE Mesh Sensor Model) ────────────────────── */
#define PROP_TEMPERATURE  0x004F
#define PROP_HUMIDITY     0x0076
#define PROP_ECO2         0x0008
#define PROP_HEART_RATE   0x0100
#define PROP_SPO2         0x0101
#define PROP_TVOC         0x0102
#define PROP_RAW_RED      0x0103
#define PROP_RAW_IR       0x0104
#define PROP_SWITCH       0x0105
#define PROP_LIGHT_STATE  0x0106
#define PROP_SENSOR_SEQ   0x07FF

/**
 * @brief Parse a Format A Marshalled Property ID.
 *
 * Layout:
 *   Bit 0      = format (0 = Format A, 1 = Format B → returns false)
 *   Bits 1–4   = length (zero-based: 0 = 1 byte, 1 = 2 bytes, ...)
 *   Bits 5–15  = Property ID (11 bits)
 *
 * @param mpid     Raw 16-bit MPID value (little-endian from wire)
 * @param prop_id  Output: decoded Property ID
 * @param data_len Output: decoded data length in bytes
 * @return true if Format A, false if Format B (unsupported)
 */
bool mesh_parse_mpid_format_a(uint16_t mpid, uint16_t *prop_id, uint8_t *data_len);

/**
 * @brief Read a little-endian signed integer (1, 2, or 4 bytes).
 */
int32_t mesh_read_le_signed(const uint8_t *data, uint8_t len);

/**
 * @brief Read a little-endian unsigned integer (1, 2, or 4 bytes).
 */
uint32_t mesh_read_le_unsigned(const uint8_t *data, uint8_t len);

/**
 * @brief Parse a full Sensor Status payload into a sensor_payload struct.
 *
 * Iterates over all MPID+value pairs in the payload and fills in
 * the fields of @p out that are recognized. Sets @p out->present bitmask.
 *
 * @param data   Raw payload bytes
 * @param len    Payload length in bytes
 * @param out    Output sensor_payload (must be zero-initialized by caller)
 * @return true if at least one property was recognized, false otherwise
 */
bool mesh_parse_sensor_status(const uint8_t *data, uint16_t len,
                              struct sensor_payload *out);

/**
 * @brief Build a Sensor Status payload for testing/simulation.
 *
 * Encodes a single property into a Format A MPID + value pair.
 * Useful for constructing test vectors.
 *
 * @param buf      Output buffer
 * @param buf_size Buffer size
 * @param prop_id  Property ID to encode
 * @param value    Value bytes (little-endian)
 * @param val_len  Length of value in bytes (1, 2, or 4)
 * @return bytes written, or 0 on error
 */
uint16_t mesh_encode_property(uint8_t *buf, uint16_t buf_size,
                              uint16_t prop_id, const uint8_t *value,
                              uint8_t val_len);

#endif /* MESH_PARSER_H */
```

## inc/model_handler.h
```c
#ifndef MODEL_HANDLER_H
#define MODEL_HANDLER_H
 
#include <zephyr/bluetooth/mesh.h>
 
const struct bt_mesh_prov *model_handler_prov_init(void);
const struct bt_mesh_comp *model_handler_comp_init(void);
void model_handler_self_provision(void);
void model_handler_start_provisioning(void);
 
/**
 * @brief Unprovision a BLE Mesh node by its unicast address.
 *
 * Sends Config Node Reset to the node (so it returns to unprovisioned
 * state and starts beaconing again), then removes it from the local CDB.
 *
 * Safe to call from any context — the actual mesh operation is
 * dispatched to the config work queue internally.
 *
 * @param mesh_addr  Unicast mesh address of the node to unprovision
 */
void model_handler_unprovision_node(uint16_t mesh_addr);
 
void model_handler_reconfigure_node(uint16_t mesh_addr);
#endif /* MODEL_HANDLER_H */
 
```

## inc/rule_engine.h
```c
#ifndef RULE_ENGINE_H
#define RULE_ENGINE_H

#include <zephyr/kernel.h>
#include "semantic_handler.h"
#include "data_handler.h"

/**
 * @file rule_engine.h
 * @brief If-Then rule engine for cross-protocol actuator control.
 *
 * Rules are evaluated on every semantic state transition.
 * A rule fires when:
 *   source node index matches AND new state matches trigger
 *
 * Actions can target:
 *   - BLE Mesh address (Generic OnOff Set via mesh_ctrl)
 *   - Thread node IPv6 (CoAP PUT to /light)
 *
 * Up to RULE_MAX rules are stored in RAM.
 * Rules survive scheduler restarts but NOT reboots (no persistence yet).
 */

#define RULE_MAX  16

/* ── Trigger types ───────────────────────────────────────────── */
typedef enum {
    RULE_TRIG_STATE_ACTIVE   = 0,  /* node enters ACTIVE              */
    RULE_TRIG_STATE_ALERT    = 1,  /* node enters ALERT               */
    RULE_TRIG_STATE_CRITICAL = 2,  /* node enters CRITICAL            */
    RULE_TRIG_STATE_IDLE     = 3,  /* node returns to IDLE            */
    RULE_TRIG_STATE_LOST     = 4,  /* node goes LOST                  */
    RULE_TRIG_SWITCH_ON      = 5,  /* node sends switch=1 payload     */
    RULE_TRIG_SWITCH_OFF     = 6,  /* node sends switch=0 payload     */
} rule_trigger_t;

/* ── Action types ────────────────────────────────────────────── */
typedef enum {
    RULE_ACT_MESH_ON     = 0,  /* Generic OnOff Set ON  → BLE Mesh addr */
    RULE_ACT_MESH_OFF    = 1,  /* Generic OnOff Set OFF → BLE Mesh addr */
    RULE_ACT_MESH_TOGGLE = 2,  /* Toggle last known state               */
    RULE_ACT_THREAD_ON   = 3,  /* CoAP PUT {"on":true}  → Thread node   */
    RULE_ACT_THREAD_OFF  = 4,  /* CoAP PUT {"on":false} → Thread node   */
    RULE_ACT_THREAD_TOGGLE = 5, /* CoAP PUT toggle last known state       */
} rule_action_t;

/* ── Rule descriptor ─────────────────────────────────────────── */
typedef struct {
    bool           active;       /* false = slot unused               */

    /* Source */
    uint8_t        src_node_idx; /* which node triggers this rule     */
    rule_trigger_t trigger;

    /* Target */
    rule_action_t  action;
    bool           target_is_thread; /* false = BLE Mesh, true = Thread */
    union {
        uint16_t mesh_addr;          /* BLE Mesh unicast or group addr  */
        char     ipv6[40];           /* Thread node IPv6 address        */
    } target;
} gateway_rule_t;

/* ── Public API ──────────────────────────────────────────────── */

void rule_engine_init(void);

/**
 * @brief Evaluate rules on a semantic state transition.
 * Call from semantic_handler after transition() completes.
 */
void rule_engine_on_state(uint8_t node_idx, node_state_t new_state, node_transport_t src_transport);

/**
 * @brief Evaluate rules on a switch event.
 * Call from data_handler_receive when sw=1 or sw=0 is in payload.
 */
void rule_engine_on_switch(uint8_t node_idx, bool sw_on, node_transport_t src_transport);

/**
 * @brief Add a rule. Returns rule index (0–15) or -1 if full.
 */
int rule_engine_add(const gateway_rule_t *rule);

/**
 * @brief Remove a rule by index.
 */
void rule_engine_remove(uint8_t idx);

/**
 * @brief Get rule by index. Returns NULL if slot unused.
 */
const gateway_rule_t *rule_engine_get(uint8_t idx);

/**
 * @brief Serialize all active rules to JSON for dashboard.
 * Writes into buf, returns bytes written.
 */
int rule_engine_to_json(char *buf, size_t size);

#endif /* RULE_ENGINE_H */
```

## inc/semantic_handler.h
```c
#ifndef SEMANTIC_HANDLER_H
#define SEMANTIC_HANDLER_H

struct node_sensor_data;  // forward declaration to avoid circular dependency
#include "data_handler.h"

/**
 * @file semantic_handler.h
 * @brief Per-node state machine and alert logic.
 *
 * Responsibilities:
 *   - Track the semantic state of each node (IDLE → ACTIVE → ALERT → CRITICAL)
 *   - Apply hysteresis so alerts don't flicker at threshold boundaries
 *   - Detect sustained conditions (time-windowed alerts)
 *   - Detect node loss (no packet for > NODE_LOST_TIMEOUT_MS)
 *   - Detect rapid trends (rising CO2, sudden motion)
 *   - Request radio scheduler priority when needed
 *
 * NOT responsible for:
 *   - Receiving or parsing packets  → data_handler.c
 *   - Forwarding via BLE/LoRa       → data_handler.c
 *   - Mesh configuration            → ble_mesh_handler.c
 */

/* ── Node semantic states ─────────────────────────────────────── */

typedef enum {
    NODE_STATE_UNKNOWN  = 0,   /* No data received yet              */
    NODE_STATE_IDLE,           /* Values within normal range        */
    NODE_STATE_ACTIVE,         /* Values elevated but not critical  */
    NODE_STATE_ALERT,          /* Threshold crossed, action needed  */
    NODE_STATE_CRITICAL,       /* Multiple thresholds or rapid rise */
    NODE_STATE_LOST,           /* No packet for NODE_LOST_TIMEOUT_MS */
} node_state_t;

/* ── Threshold configuration ─────────────────────────────────── */

/* Environmental — can be overridden at runtime via semantic_handler_set_thresholds() */
#define THRESH_CO2_ACTIVE    1000   /* ppm  — elevated  */
extern int32_t thresh_co2_alert;   /* ppm  — alert     */
#define THRESH_CO2_CRITICAL  5000   /* ppm  — critical  */
#define THRESH_CO2_HYST       200   /* ppm  — hysteresis band */

#define THRESH_TVOC_ACTIVE    150   /* ppb */
extern int32_t thresh_tvoc_alert;   /* ppb */
#define THRESH_TVOC_HYST       50   /* ppb */

extern int32_t thresh_temp_alert;   /* m°C = 38.0 °C */
#define THRESH_TEMP_HYST     1000   /* m°C = 1.0 °C  */

/* IMU — magnitude² in (mg/100)² to avoid sqrt */
extern int32_t thresh_motion_active;   /* ~2g  */
extern int32_t thresh_motion_alert;   /* ~10g */
#define THRESH_MOTION_HYST     100

/* Trend: alert if metric rises by this much within the window */
#define TREND_CO2_RISE_PPM    300   /* ppm per window */
#define TREND_WINDOW_MS      5000   /* ms              */

/* Node loss timeout */
extern int32_t node_lost_timeout_ms;   /* 30 s */

/* Minimum time a condition must persist before triggering alert */
#define SUSTAINED_ALERT_MS    5000   /* 5 s */


/* ── Public API ───────────────────────────────────────────────── */

int  semantic_handler_init(void);

/**
 * @brief Process one received sensor packet.
 * Called by data_handler_receive() after logging/forwarding.
 */
void semantic_handler_process(const struct node_sensor_data *d);

/**
 * @brief Periodic tick — call from a timer or work queue.
 * Checks for node loss and clears expired transient states.
 * Recommended interval: 1–5 seconds.
 */
void semantic_handler_tick(void);

/**
 * @brief Get the current semantic state of a node by index.
 * Returns NODE_STATE_UNKNOWN if the index is out of range.
 */
node_state_t semantic_handler_get_state(uint8_t node_idx);

/**
 * @brief Return a human-readable string for a state value.
 */
const char *semantic_handler_state_str(node_state_t state);

void semantic_handler_set_policy(int32_t motion_active, int32_t motion_alert, int32_t co2_alert, int32_t temp_alert, int32_t tvoc_alert);

#endif /* SEMANTIC_HANDLER_H */
```

## inc/thread_handler.h
```c
#ifndef THREAD_HANDLER_H
#define THREAD_HANDLER_H

/**
 * @brief Initialize OpenThread CoAP receiver.
 *
 * Opens a UDP socket on port 5683, binds it, and starts
 * a background thread that dispatches incoming CoAP requests.
 *
 * @return 0 on success, negative errno on failure.
 */
int thread_handler_init(void);
void thread_handler_nus_ready(void);
int thread_handler_coap_put_light(const char *ipv6, bool on);

#endif /* THREAD_HANDLER_H */
```

## inc/wire_format.h
```c
#ifndef WIRE_FORMAT_H
#define WIRE_FORMAT_H

/**
 * @file wire_format.h
 * @brief LoRa binary wire format serializer/deserializer.
 *
 * Extracted from data_handler.c to allow unit testing.
 *
 * Frame layout (worst case = 36 bytes):
 *
 *   Offset  Size  Field
 *   ──────  ────  ──────────────────────────────────────────────
 *   0       1     node_idx
 *   1       1     transport  (0=Thread, 1=BLE Mesh)
 *   2       4     present bitmask (little-endian, low 32 bits)
 *   ── then only fields whose bit is set, in order: ──────────
 *   +0      2     ax  [int16_t, mg, little-endian]
 *   +2      2     ay
 *   +4      2     az
 *   +6      2     gx  [int16_t, mdeg/s]
 *   +8      2     gy
 *   +10     2     gz
 *   +12     2     temp [int16_t, m°C / 10 → 0.1°C resolution]
 *   +14     2     hum  [int16_t, m%RH / 10]
 *   +16     2     tvoc [uint16_t, ppb]
 *   +18     2     eco2 [uint16_t, ppm]
 *   +20     1     heart_rate [uint8_t, bpm]
 *   +21     2     spo2 [uint16_t, m% / 10]
 *   +23     2     pm25 [uint16_t, µg/m³]
 *   +25     2     pm10 [uint16_t, µg/m³]
 *   +27     1     switch_state [uint8_t]
 */

#include <stdint.h>
#include "data_handler.h"

#define WIRE_MAX_SIZE 50  /* 6-byte header + max payload */

/**
 * @brief Serialize sensor data into LoRa binary wire format.
 *
 * @param d    Source sensor data
 * @param buf  Output buffer (must be >= WIRE_MAX_SIZE bytes)
 * @param size Buffer size
 * @return Number of bytes written, or 0 on error
 */
int wire_build(const struct node_sensor_data *d, uint8_t *buf, size_t size);

/**
 * @brief Deserialize LoRa binary wire format back into sensor data.
 * Used for verification in tests and on the receiver side.
 *
 * @param buf  Input buffer
 * @param len  Buffer length
 * @param out  Output sensor data (zeroed by caller)
 * @return true on success, false on malformed input
 */
bool wire_parse(const uint8_t *buf, size_t len, struct node_sensor_data *out);

#endif /* WIRE_FORMAT_H */
```
