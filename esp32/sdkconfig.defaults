## esp32/sdkconfig.defaults
```kconfig
CONFIG_OPENTHREAD_ENABLED=y
CONFIG_OPENTHREAD_FTD=y
CONFIG_LWIP_IPV6=y
CONFIG_LWIP_IPV6_NUM_ADDRESSES=6
CONFIG_VFS_SUPPORT_IO=y
CONFIG_VFS_SUPPORT_SELECT=y
CONFIG_VFS_EVENTFD_SUPPORT=y
CONFIG_VFS_EVENTFD_MAX=5
CONFIG_LWIP_USE_ONLY_LWIP_SELECT=n
```
